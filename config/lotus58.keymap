/*
 * Copyright (c) 2022 The ZMK Contributors
 *
 * SPDX-License-Identifier: MIT
 */

#include <behaviors.dtsi>
#include <dt-bindings/zmk/keys.h>
#include <dt-bindings/zmk/bt.h>
#include <dt-bindings/zmk/outputs.h>
#include <dt-bindings/zmk/rgb.h>
#include <dt-bindings/led/led.h>

// OLED Configuration
&pro_micro_i2c {
    status = "okay";

    oled: ssd1306@3c {
        compatible = "solomon,ssd1306fb";
        reg = <0x3c>;
        width = <128>;
        height = <64>;
        segment-offset = <0>;
        page-offset = <0>;
        display-offset = <0>;
        multiplex-ratio = <63>;
        prechargep = <0xF1>;
        /delete-property/ segment-remap;
    };
};

// RGB LED Configuration
&pinctrl {
    spi3_default: spi3_default {
        group1 {
            psels = <NRF_PSEL(SPIM_MOSI, 0, 6)>;
        };
    };

    spi3_sleep: spi3_sleep {
        group1 {
            psels = <NRF_PSEL(SPIM_MOSI, 0, 6)>;
            low-power-enable;
        };
    };
};

&spi3 {
    compatible = "nordic,nrf-spim";
    status = "okay";

    pinctrl-0 = <&spi3_default>;
    pinctrl-1 = <&spi3_sleep>;
    pinctrl-names = "default", "sleep";

    led_strip: ws2812@0 {
        compatible = "worldsemi,ws2812-spi";
        reg = <0>;
        spi-max-frequency = <4000000>;
        chain-length = <29>;
        spi-one-frame = <0x70>;
        spi-zero-frame = <0x40>;
        color-mapping = <LED_COLOR_ID_GREEN LED_COLOR_ID_RED LED_COLOR_ID_BLUE>;
    };
};

/ {
    chosen {
        zmk,underglow = &led_strip;
    };
};

// Custom behaviors for professional programming
/ {
    behaviors {
        // Homerow mods for efficient typing
        hm: homerow_mods {
            compatible = "zmk,behavior-hold-tap";
            #binding-cells = <2>;
            tapping-term-ms = <175>;
            quick-tap-ms = <0>;
            flavor = "tap-preferred";
            bindings = <&kp>, <&kp>;
        };

        // Tap dance for brackets
        td_brc: tap_dance_brackets {
            compatible = "zmk,behavior-tap-dance";
            #binding-cells = <0>;
            tapping-term-ms = <200>;
            bindings = <&kp LBRC>, <&kp LBKT>, <&kp LPAR>;
        };

        td_brc_r: tap_dance_brackets_right {
            compatible = "zmk,behavior-tap-dance";
            #binding-cells = <0>;
            tapping-term-ms = <200>;
            bindings = <&kp RBRC>, <&kp RBKT>, <&kp RPAR>;
        };

        // Shift + Caps Word
        caps_word_shift: caps_word_shift {
            compatible = "zmk,behavior-mod-morph";
            #binding-cells = <0>;
            bindings = <&kp LSHFT>, <&caps_word>;
            mods = <(MOD_LSFT)>;
        };

        // Smart quotes
        smart_quote: smart_quote {
            compatible = "zmk,behavior-mod-morph";
            #binding-cells = <0>;
            bindings = <&kp SQT>, <&kp DQT>;
            mods = <(MOD_LSFT|MOD_RSFT)>;
        };

        // Programming symbols
        prog_sym: programming_symbols {
            compatible = "zmk,behavior-mod-morph";
            #binding-cells = <0>;
            bindings = <&kp EQUAL>, <&kp PLUS>;
            mods = <(MOD_LSFT|MOD_RSFT)>;
        };

        // Git commit shortcut
        git_commit: git_commit {
            compatible = "zmk,behavior-macro";
            #binding-cells = <0>;
            bindings = <&kp G &kp I &kp T &kp SPACE &kp C &kp O &kp M &kp M &kp I &kp T &kp SPACE &kp MINUS &kp M &kp SPACE>;
        };

        // Vim save and quit
        vim_wq: vim_wq {
            compatible = "zmk,behavior-macro";
            #binding-cells = <0>;
            bindings = <&kp ESC &kp COLON &kp W &kp Q &kp ENTER>;
        };

        // Fast Bluetooth switching
        bt_0: bt_profile_0 {
            compatible = "zmk,behavior-macro";
            #binding-cells = <0>;
            bindings = <&bt BT_SEL 0>, <&rgb_ug RGB_COLOR_HSB(120,100,50)>;
        };

        bt_1: bt_profile_1 {
            compatible = "zmk,behavior-macro";
            #binding-cells = <0>;
            bindings = <&bt BT_SEL 1>, <&rgb_ug RGB_COLOR_HSB(240,100,50)>;
        };

        bt_2: bt_profile_2 {
            compatible = "zmk,behavior-macro";
            #binding-cells = <0>;
            bindings = <&bt BT_SEL 2>, <&rgb_ug RGB_COLOR_HSB(0,100,50)>;
        };
    };

    // Combos for efficient programming
    combos {
        compatible = "zmk,combos";

        // Quick access to common programming symbols
        combo_underscore {
            timeout-ms = <50>;
            key-positions = <21 22>; // S + D
            bindings = <&kp UNDER>;
        };

        combo_pipe {
            timeout-ms = <50>;
            key-positions = <22 23>; // D + F
            bindings = <&kp PIPE>;
        };

        combo_ampersand {
            timeout-ms = <50>;
            key-positions = <23 24>; // F + G
            bindings = <&kp AMPS>;
        };

        combo_arrow_fn {
            timeout-ms = <50>;
            key-positions = <16 17>; // E + R
            bindings = <&kp EQUAL &kp GT>;
        };

        combo_git_commit {
            timeout-ms = <50>;
            key-positions = <26 27>; // C + V
            bindings = <&git_commit>;
        };

        combo_vim_save {
            timeout-ms = <50>;
            key-positions = <27 28>; // V + B
            bindings = <&vim_wq>;
        };

        // Quick layer access
        combo_adjust {
            timeout-ms = <50>;
            key-positions = <37 40>; // Both layer keys
            bindings = <&mo 4>;
        };
    };

    keymap {
        compatible = "zmk,keymap";

        // Layer 0: Base QWERTY with homerow mods
        base_layer {
            bindings = <
&kp ESC       &kp N1    &kp N2    &kp N3    &kp N4    &kp N5                                      &kp N6    &kp N7    &kp N8    &kp N9    &kp N0    &kp BSPC
&kp TAB       &kp Q     &kp W     &kp E     &kp R     &kp T                                       &kp Y     &kp U     &kp I     &kp O     &kp P     &kp DEL
&caps_word_shift &hm LGUI A &hm LALT S &hm LCTRL D &hm LSHFT F &kp G    &kp C_MUTE    &kp C_PP    &kp H     &hm RSHFT J &hm RCTRL K &hm RALT L &hm RGUI SEMI &smart_quote
&kp LCTRL     &kp Z     &kp X     &kp C     &kp V     &kp B     &mo 3     &mo 4         &kp N     &kp M     &kp COMMA &kp DOT   &kp FSLH  &kp RSHFT
                                  &kp LALT  &kp SPACE &mo 1     &kp ENTER                 &kp ENTER &mo 2     &kp BSPC  &kp RGUI
            >;
            sensor-bindings = <&inc_dec_kp C_VOL_DN C_VOL_UP &inc_dec_kp PG_UP PG_DN>;
        };

        // Layer 1: Numbers, Navigation & Function keys
        lower_layer {
            bindings = <
&kp GRAVE     &kp F1    &kp F2    &kp F3    &kp F4    &kp F5                                      &kp F6    &kp F7    &kp F8    &kp F9    &kp F10   &kp F11
&kp TILDE     &kp N1    &kp N2    &kp N3    &kp N4    &kp N5                                      &kp N6    &kp N7    &kp N8    &kp N9    &kp N0    &kp F12
&trans        &kp EXCL  &kp AT    &kp HASH  &kp DLLR  &kp PRCNT &trans         &trans           &kp CARET &kp AMPS  &kp STAR  &kp LPAR  &kp RPAR  &kp PIPE
&trans        &kp EQUAL &kp MINUS &kp PLUS  &td_brc   &td_brc_r &trans         &trans           &kp HOME  &kp LEFT  &kp DOWN  &kp UP    &kp RIGHT &kp END
                                  &trans    &trans    &trans    &trans                           &trans    &trans    &trans    &trans
            >;
            sensor-bindings = <&inc_dec_kp C_VOL_DN C_VOL_UP &inc_dec_kp LEFT RIGHT>;
        };

        // Layer 2: Symbols & Programming
        raise_layer {
            bindings = <
&kp ESC       &kp EXCL  &kp AT    &kp HASH  &kp DLLR  &kp PRCNT                                   &kp CARET &kp AMPS  &kp STAR  &kp LPAR  &kp RPAR  &kp BSPC
&kp TAB       &kp EXCL  &kp AT    &kp LBRC  &kp RBRC  &kp PIPE                                    &kp BSLH  &kp N7    &kp N8    &kp N9    &kp STAR  &kp DEL
&trans        &kp HASH  &kp DLLR  &kp LPAR  &kp RPAR  &kp GRAVE &trans         &trans           &prog_sym &kp N4    &kp N5    &kp N6    &kp PLUS  &kp ENTER
&trans        &kp PRCNT &kp CARET &kp LBKT  &kp RBKT  &kp TILDE &trans         &trans           &kp N0    &kp N1    &kp N2    &kp N3    &kp MINUS &trans
                                  &trans    &trans    &trans    &trans                           &trans    &trans    &trans    &trans
            >;
            sensor-bindings = <&inc_dec_kp C_VOL_DN C_VOL_UP &inc_dec_kp C_BRI_DN C_BRI_UP>;
        };

        // Layer 3: System & Media
        function_layer {
            bindings = <
&kp ESC       &kp F1    &kp F2    &kp F3    &kp F4    &kp F5                                      &kp F6    &kp F7    &kp F8    &kp F9    &kp F10   &kp F11
&trans        &kp INS   &kp PSCRN &kp SLCK  &kp PAUSE_BREAK &trans                              &trans    &trans    &trans    &trans    &trans    &kp F12
&trans        &trans    &trans    &trans    &trans    &trans    &trans         &trans           &kp LEFT  &kp DOWN  &kp UP    &kp RIGHT &trans    &trans
&trans        &trans    &trans    &trans    &trans    &trans    &trans         &trans           &kp HOME  &kp PG_DN &kp PG_UP &kp END   &trans    &trans
                                  &trans    &trans    &trans    &trans                           &trans    &trans    &trans    &trans
            >;
            sensor-bindings = <&inc_dec_kp C_VOL_DN C_VOL_UP &inc_dec_kp C_NEXT C_PREV>;
        };

        // Layer 4: RGB, Bluetooth & Adjust
        adjust_layer {
            bindings = <
&sys_reset    &bt_0     &bt_1     &bt_2     &bt BT_CLR &out OUT_TOG                                &rgb_ug RGB_TOG &rgb_ug RGB_EFF &rgb_ug RGB_EFR &trans &trans &sys_reset
&bootloader   &trans    &trans    &trans    &trans    &trans                                      &rgb_ug RGB_HUI &rgb_ug RGB_SAI &rgb_ug RGB_BRI &trans &trans &bootloader
&trans        &trans    &trans    &trans    &trans    &trans    &trans         &trans           &rgb_ug RGB_HUD &rgb_ug RGB_SAD &rgb_ug RGB_BRD &trans &trans &trans
&trans        &trans    &trans    &trans    &trans    &trans    &trans         &trans           &rgb_ug RGB_SPI &rgb_ug RGB_SPD &trans          &trans &trans &trans
                                  &trans    &trans    &trans    &trans                           &trans          &trans          &trans          &trans
            >;
            sensor-bindings = <&inc_dec_kp C_VOL_DN C_VOL_UP &inc_dec_kp C_BRI_DN C_BRI_UP>;
        };
    };
};

/*
 * OLED Display Animations and Custom Features
 * Add this to your keymap file after the main configuration
 */

#ifdef CONFIG_ZMK_DISPLAY

// Custom OLED timeout for animations
#define OLED_TIMEOUT 30000

// Animation frames for idle state
static const char PROGMEM lotus_logo[] = {
    0x00, 0x00, 0x00, 0x00, 0x00, 0x00, 0x00, 0x00, 0x00, 0x00, 0x00, 0x00, 0x00, 0x00, 0x00, 0x00,
    0x00, 0x00, 0x00, 0x00, 0x00, 0x00, 0x00, 0x00, 0x00, 0x00, 0x00, 0x00, 0x00, 0x00, 0x00, 0x00,
    0x00, 0x00, 0x00, 0x00, 0x00, 0x00, 0x00, 0x80, 0xc0, 0xe0, 0xf0, 0xf8, 0xfc, 0xfe, 0xff, 0xff,
    0xff, 0xff, 0xfe, 0xfc, 0xf8, 0xf0, 0xe0, 0xc0, 0x80, 0x00, 0x00, 0x00, 0x00, 0x00, 0x00, 0x00,
    0x00, 0x00, 0x00, 0x00, 0x00, 0x00, 0x00, 0x00, 0x00, 0x00, 0x00, 0x00, 0x00, 0x00, 0x00, 0x00,
    0x00, 0x00, 0x00, 0x00, 0x00, 0x00, 0x00, 0x00, 0x00, 0x00, 0x00, 0x00, 0x00, 0x00, 0x00, 0x00,
    0x00, 0x00, 0x00, 0x00, 0x00, 0x00, 0x00, 0x00, 0x00, 0x00, 0x00, 0x00, 0x00, 0x00, 0x00, 0x00,
    0x00, 0x00, 0x00, 0x00, 0x00, 0x00, 0x00, 0x00, 0x00, 0x00, 0x00, 0x00, 0x00, 0x00, 0x00, 0x00
};

// Typing animation frames
static const char PROGMEM typing_frames[][32] = {
    {
        0x00, 0x00, 0x00, 0x00, 0x00, 0x00, 0x00, 0x00,
        0x00, 0x00, 0x00, 0x00, 0x00, 0x00, 0x00, 0x00,
        0x00, 0x00, 0x00, 0x00, 0x00, 0x00, 0x00, 0x00,
        0x00, 0x00, 0x00, 0x00, 0x00, 0x00, 0x00, 0x00
    },
    {
        0x00, 0x00, 0x00, 0x00, 0x00, 0x00, 0x00, 0x00,
        0x00, 0x00, 0x00, 0x00, 0x00, 0x00, 0x00, 0x00,
        0x00, 0x00, 0x00, 0x00, 0x00, 0x00, 0x00, 0x00,
        0x00, 0x00, 0x00, 0x00, 0x00, 0x00, 0x00, 0x00
    }
};

// WPM calculation variables
static uint32_t wpm_timer = 0;
static uint16_t wpm_count = 0;
static uint8_t current_wpm = 0;

// Custom OLED display function
void oled_render_layer_state(void) {
    oled_write_P(PSTR("Layer: "), false);
    switch (get_highest_layer(layer_state)) {
        case 0:
            oled_write_P(PSTR("Base   "), false);
            break;
        case 1:
            oled_write_P(PSTR("Lower  "), false);
            break;
        case 2:
            oled_write_P(PSTR("Raise  "), false);
            break;
        case 3:
            oled_write_P(PSTR("Func   "), false);
            break;
        case 4:
            oled_write_P(PSTR("Adjust "), false);
            break;
        default:
            oled_write_P(PSTR("Undef  "), false);
    }
}

void oled_render_mod_status(void) {
    oled_write_P(PSTR("Mods: "), false);
    uint8_t mods = get_mods() | get_oneshot_mods();

    oled_write_P((mods & MOD_MASK_CTRL) ? PSTR("C") : PSTR("-"), false);
    oled_write_P((mods & MOD_MASK_ALT) ? PSTR("A") : PSTR("-"), false);
    oled_write_P((mods & MOD_MASK_GUI) ? PSTR("G") : PSTR("-"), false);
    oled_write_P((mods & MOD_MASK_SHIFT) ? PSTR("S") : PSTR("-"), false);
}

void oled_render_wpm(void) {
    char wpm_str[10];
    sprintf(wpm_str, "WPM: %d", current_wpm);
    oled_write(wpm_str, false);
}

void oled_render_battery_status(void) {
    // This would need battery sensing hardware
    oled_write_P(PSTR("BAT: 85%"), false);
}

void oled_render_bluetooth_status(void) {
    oled_write_P(PSTR("BT: "), false);
    switch (selected_profile) {
        case 0:
            oled_write_P(PSTR("1"), false);
            break;
        case 1:
            oled_write_P(PSTR("2"), false);
            break;
        case 2:
            oled_write_P(PSTR("3"), false);
            break;
        default:
            oled_write_P(PSTR("?"), false);
    }

    if (bt_is_connected()) {
        oled_write_P(PSTR(" CON"), false);
    } else {
        oled_write_P(PSTR(" DIS"), false);
    }
}

void oled_render_time_date(void) {
    // Static time display (would need RTC for real time)
    oled_write_P(PSTR("14:30"), false);
    oled_write_P(PSTR(" 29/06"), false);
}

void oled_render_logo_animation(void) {
    static uint8_t frame = 0;
    static uint32_t anim_timer = 0;

    if (timer_elapsed32(anim_timer) > 500) {
        frame = (frame + 1) % 4;
        anim_timer = timer_read32();
    }

    // Simple breathing effect
    for (int i = 0; i < 8; i++) {
        oled_write_P(frame % 2 ? PSTR("*") : PSTR(" "), false);
    }
    oled_write_P(PSTR("LOTUS58"), false);
    for (int i = 0; i < 8; i++) {
        oled_write_P(frame % 2 ? PSTR("*") : PSTR(" "), false);
    }
}

void oled_render_caps_word_status(void) {
    if (is_caps_word_on()) {
        oled_write_P(PSTR("CAPS WORD"), false);
    } else {
        oled_write_P(PSTR("         "), false);
    }
}

// Main OLED task
bool oled_task_user(void) {
    static uint32_t last_update = 0;

    if (timer_elapsed32(last_update) < 100) {
        return false;
    }
    last_update = timer_read32();

    if (is_keyboard_master()) {
        // Left side display
        oled_render_logo_animation();
        oled_write_P(PSTR("\n"), false);

        oled_render_layer_state();
        oled_write_P(PSTR("\n"), false);

        oled_render_mod_status();
        oled_write_P(PSTR("\n"), false);

        oled_render_wpm();
        oled_write_P(PSTR("\n"), false);

        oled_render_caps_word_status();
        oled_write_P(PSTR("\n"), false);

        oled_render_time_date();

    } else {
        // Right side display
        oled_render_bluetooth_status();
        oled_write_P(PSTR("\n"), false);

        oled_render_battery_status();
        oled_write_P(PSTR("\n"), false);

        // RGB status
        if (rgb_matrix_is_enabled()) {
            char rgb_str[20];
            sprintf(rgb_str, "RGB: %d %d %d",
                    rgb_matrix_get_hue(),
                    rgb_matrix_get_sat(),
                    rgb_matrix_get_val());
            oled_write(rgb_str, false);
        } else {
            oled_write_P(PSTR("RGB: OFF"), false);
        }
        oled_write_P(PSTR("\n"), false);

        // System status
        oled_write_P(PSTR("SYS: OK"), false);
        oled_write_P(PSTR("\n"), false);

        // Temperature (simulated)
        oled_write_P(PSTR("TEMP: 25C"), false);
        oled_write_P(PSTR("\n"), false);

        // Uptime counter
        static uint32_t uptime_counter = 0;
        if (timer_elapsed32(uptime_counter) > 1000) {
            uptime_counter = timer_read32();
        }
        char uptime_str[15];
        sprintf(uptime_str, "UP: %dh %dm",
                (int)(timer_read32() / 3600000),
                (int)((timer_read32() % 3600000) / 60000));
        oled_write(uptime_str, false);
    }

    return false;
}

// WPM tracking
bool process_record_user(uint16_t keycode, keyrecord_t *record) {
    if (record->event.pressed) {
        // Update WPM counter
        wpm_count++;
        if (timer_elapsed32(wpm_timer) > 60000) { // Every minute
            current_wpm = wpm_count;
            wpm_count = 0;
            wpm_timer = timer_read32();
        }
    }
    return true;
}

// Layer change RGB effects
layer_state_t layer_state_set_user(layer_state_t state) {
    switch (get_highest_layer(state)) {
        case 0: // Base layer - soft white
            rgb_matrix_sethsv_noeeprom(0, 0, 100);
            break;
        case 1: // Lower - blue
            rgb_matrix_sethsv_noeeprom(240, 255, 150);
            break;
        case 2: // Raise - green
            rgb_matrix_sethsv_noeeprom(120, 255, 150);
            break;
        case 3: // Function - purple
            rgb_matrix_sethsv_noeeprom(300, 255, 150);
            break;
        case 4: // Adjust - red
            rgb_matrix_sethsv_noeeprom(0, 255, 150);
            break;
    }
    return state;
}

// Caps Word RGB effect
void caps_word_set_user(bool active) {
    if (active) {
        rgb_matrix_sethsv_noeeprom(60, 255, 200); // Yellow
    } else {
        // Return to layer color
        layer_state_set_user(layer_state);
    }
}

#endif // CONFIG_ZMK_DISPLAY
